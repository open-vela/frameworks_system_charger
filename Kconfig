## Kconfig
```kconfig
#
# Copyright (C) 2023 Xiaomi Corporation
#
# Licensed under the Apache License, Version 2.0 (the "License");
# you may not use this file except in compliance with the License.
# You may obtain a copy of the License at
#
#      http://www.apache.org/licenses/LICENSE-2.0
#
# Unless required by applicable law or agreed to in writing, software
# distributed under the License is distributed on an "AS IS" BASIS,
# WITHOUT WARRANTIES OR CONDITIONS OF ANY KIND, either express or implied.
# See the License for the specific language governing permissions and
# limitations under the License.
#

menu "CHARGERD CONFIG"

config CHARGERD
	bool "chargerd"
	depends on BATTERY_CHARGER && BATTERY_GAUGE
	select NETUTILS_CJSON
	default n
	---help---
		This application is used to manager charge logic

if CHARGERD

config CHARGERD_HWINTF_CONVERSION
	bool "hwintf conversion"
	default n
	---help---
		This application is used to battery data conversion

config CHARGERD_SYNC_CHARGE_STATE
	bool "sync charge state to gauge"
	default n
	---help---
		This application is used to sync charge state to gauge.

config CHARGER_CONFIGURATION_FILE_PATH
	string "File path of charging related configuration parameters"
	default "/etc/charger_parameters.json"

config CHARGERD_PROGNAME
	string "Program name"
	default "chargerd"
	---help---
		This is the name of the program that will be use when the NSH ELF
		program is installed.

config CHARGERD_PRIORITY
	int "chargerd task priority"
	default 100

config CHARGERD_STACKSIZE
	int "chargerd stack size"
	default DEFAULT_TASK_STACKSIZE

endif

endmenu # CHARGERD CONFIG
```
